## boards/shields/netrunner/Kconfig.defconfig
```kconfig
if SHIELD_NETRUNNER_LEFT

config ZMK_KEYBOARD_NAME
    default "netrunner"

config ZMK_SPLIT_ROLE_CENTRAL
    default y

endif

if SHIELD_NETRUNNER_LEFT || SHIELD_NETRUNNER_RIGHT

config ZMK_SPLIT
    default y

endif
```

## boards/shields/netrunner/Kconfig.shield
```kconfig
config SHIELD_NETRUNNER_LEFT
    def_bool $(shields_list_contains,netrunner_left)

config SHIELD_NETRUNNER_RIGHT
    def_bool $(shields_list_contains,netrunner_right)
```
